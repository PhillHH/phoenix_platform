## phoenix-ui/sdkconfig.defaults
```kconfig
# Phoenix v108.0 — ESP32-S3 UI/Connectivity MCU
# Target: ESP32-S3 (QT021WVC02-B1323A / T-RGB)
# Display: ER-TFT021-1, 480x480, ST7701S, RGB interface
CONFIG_IDF_TARGET="esp32s3"
CONFIG_ESPTOOLPY_FLASHSIZE_16MB=y
CONFIG_ESPTOOLPY_FLASHFREQ_80M=y
CONFIG_ESPTOOLPY_FLASHMODE_QIO=y
CONFIG_SPIRAM=y
CONFIG_SPIRAM_MODE_OCT=y
CONFIG_SPIRAM_SPEED_80M=y
CONFIG_SPIRAM_USE_MALLOC=y
CONFIG_SPIRAM_MALLOC_ALWAYSINTERNAL=4096
CONFIG_ESP32S3_DEFAULT_CPU_FREQ_240=y
CONFIG_FREERTOS_HZ=1000
CONFIG_LCD_RGB_ISR_IRAM_SAFE=y
CONFIG_ESP_WIFI_MODE_STA=y
CONFIG_LV_MEM_CUSTOM=y
CONFIG_LV_MEM_SIZE_KILOBYTES=64
CONFIG_LV_COLOR_DEPTH_16=y
CONFIG_LV_FONT_MONTSERRAT_14=y
CONFIG_LV_FONT_MONTSERRAT_18=y
CONFIG_LV_FONT_MONTSERRAT_20=y
CONFIG_LV_FONT_MONTSERRAT_24=y
CONFIG_LV_FONT_MONTSERRAT_28=y
CONFIG_LV_FONT_MONTSERRAT_32=y
CONFIG_LV_FONT_MONTSERRAT_48=y
CONFIG_LV_USE_ANIMATION=y
CONFIG_LV_DISP_DEF_REFR_PERIOD=16
CONFIG_LOG_DEFAULT_LEVEL_INFO=y
CONFIG_FREERTOS_CHECK_STACKOVERFLOW_CANARY=y
CONFIG_HEAP_POISONING_COMPREHENSIVE=y
CONFIG_ESP_CONSOLE_USB_SERIAL_JTAG=y
```
